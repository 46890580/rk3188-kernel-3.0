## drivers/input/sensors/temperature/Kconfig
```kconfig
#
# temperature sensor drivers configuration
#

menuconfig TEMPERATURE_DEVICE
	bool "temperature sensor device support"
	default n

if TEMPERATURE_DEVICE
 config TMP_MS5607
 bool "temperature sensor ms5607"
 default n
 
 config TMP_TC74
 bool "temperature sensor tc74"
 default n

endif
```

## drivers/video/rockchip/hdmi/chips/it6811/Kconfig
```kconfig
config SUPPORT_HDCP
	bool "HDCP support"
        depends on MHL_IT6811
        default n
	help
	  HDCP Interface. This adds the High Definition Content Protection Interface.
	  See http://www.digital-cp.com/ for HDCP specification.
```
